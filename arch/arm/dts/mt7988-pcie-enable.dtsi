// SPDX-License-Identifier: GPL-2.0
/*
 * Copyright (c) 2022 MediaTek Inc.
 * Author: Sam Shih <sam.shih@mediatek.com>
 */

&pcie0 {
	status = "okay";
};

&pcie1 {
	status = "okay";
};

&pcie3 {
	status = "okay";
};
